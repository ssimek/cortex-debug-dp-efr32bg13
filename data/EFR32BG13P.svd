# EFR32BG13P532F512GM32 register map
File version: 5.8.2
Silicon Labs EFR32BG13P532F512GM32 Cortex-M MCU
CPU: CM4 r0p1, little endian, MPU, FPU, 3 interrupt priority bits
Registers are 32-bit, read-write, reset 0x0 unless marked. A register's access mark holds for its fields unless they carry their own. Offsets are from the block's base; lines under a group give offsets from that group; [hi:lo] are bit positions; {n}, {i} and the like mark numbered series; 'fields as' and 'values as' point back to an identical list; <NAME> marks a mode.

## Memory map
0x40000000 ACMP0 size 0x400
0x40000400 ACMP1 size 0x400
0x40002000 ADC0 size 0x400
0x40006000 IDAC0 size 0x400
0x40008000 VDAC0 size 0x400
0x4000A000 GPIO size 0x1000
0x4000C000 I2C0 size 0x400
0x4000C400 I2C1 size 0x400
0x40010000 USART0 size 0x400
0x40010400 USART1 size 0x400
0x40010800 USART2 size 0x400
0x40018000 TIMER0 size 0x400
0x40018400 TIMER1 size 0x400
0x4001A000 WTIMER0 size 0x400
0x4001C000 GPCRC size 0x400
0x4001D000 TRNG0 size 0x400
0x4001E000 CRYOTIMER size 0x400
0x4001F000 CSEN size 0x400
0x40022000 SMU size 0x400
0x40042000 RTCC size 0x400
0x40044000 PRORTC size 0x40
0x40046000 LETIMER0 size 0x400
0x4004A000 LEUART0 size 0x400
0x4004E000 PCNT0 size 0x400
0x40052000 WDOG0 size 0x400
0x40052400 WDOG1 size 0x400
0x40055000 LESENSE size 0x400
0x400E0000 MSC size 0x800
0x400E1000 FPUEH size 0x400
0x400E2000 LDMA size 0x1000
0x400E3000 EMU size 0x400
0x400E4000 CMU size 0x400
0x400E5000 RMU size 0x400
0x400E6000 PRS size 0x400
0x400F0000 CRYPTO0 size 0x400
0x400F0400 CRYPTO1 size 0x400
0xE0000E00 ITM size 0x100 — Instrumentation Trace Macrocell
0xE000E008 SCB_ACTRL size 0x5 — System control block ACTLR
0xE000E010 STK size 0x11 — SysTick timer
0xE000E100 NVIC_ISER size 0x8 — Nested vectored interrupt controller
0xE000E180 NVIC_ICER size 0x8 — Nested vectored interrupt controller
0xE000E200 NVIC_ISPR size 0x8 — Nested vectored interrupt controller
0xE000E280 NVIC_ICPR size 0x8 — Nested vectored interrupt controller
0xE000E300 NVIC_IABR size 0x8 — Nested vectored interrupt controller
0xE000E400 NVIC_IP size 0x30 — Nested vectored interrupt controller
0xE000ED00 SCB size 0x41 — System control block
0xE000ED88 FPU_CPACR size 0x5 — Floating point unit CPACR
0xE000ED90 MPU size 0x15 — Memory protection unit
0xE000EF00 NVIC_STIR size 0x4 — Nested vectored interrupt controller
0xE000EF34 FPU size 0xD — Floting point unit
0xE0040000 TPIU size 0x30C — Trace Port Interface Unit
0xE0041000 ETM size 0x40000
0xE0042000 DBGMCU size 0x15 — MCU debug component

## Interrupts
0 EMU
2 WDOG0
3 WDOG1
9 LDMA
10 GPIO_EVEN (GPIO)
11 TIMER0
12 USART0_RX (USART0)
13 USART0_TX (USART0)
14 ACMP0 (ACMP0, ACMP1)
15 ADC0
16 IDAC0
17 I2C0
18 GPIO_ODD (GPIO)
19 TIMER1
20 USART1_RX (USART1)
21 USART1_TX (USART1)
22 LEUART0
23 PCNT0
24 CMU
25 MSC
26 CRYPTO0
27 LETIMER0
30 PRORTC
31 RTCC
33 CRYOTIMER
35 FPUEH
36 SMU
37 WTIMER0
38 USART2_RX (USART2)
39 USART2_TX (USART2)
40 I2C1
41 VDAC0
42 CSEN
43 LESENSE
44 CRYPTO1
45 TRNG0
81 FPU — Floating point unit interrupt

## Further device data
name=Copyright 2019 Silicon Laboratories, Inc., flashBaseAddress=0x00000000, flashSize=0x00080000, flashAccessTypes=rx, sramBaseAddress=0x20000000, sramSize=0x00010000, sramAccessTypes=rwx

## Licence text in the file
******************************************************************************* * @version 5.8.2 ******************************************************************************* * # License * Copyright 2019 Silicon Laboratories Inc. www.silabs.com ******************************************************************************* * * SPDX-License-Identifier: Zlib * * The licensor of this software is Silicon Laboratories Inc. * * This software is provided 'as-is', without any express or implied * warranty. In no event will the authors be held liable for any damages * arising from the use of this software. * * Permission is granted to anyone to use this software for any purpose, * including commercial applications, and to alter it and redistribute it * freely, subject to the following restrictions: * * 1. The origin of this software must not be misrepresented; you must not * claim that you wrote the original software. If you use this software * in a product, an acknowledgment in the product documentation would be * appreciated but is not required. * 2. Altered source versions must be plainly marked as such, and must not be * misrepresented as being the original software. * 3. This notice may not be removed or altered from any source distribution. * *******************************************************************************
